## drivers/fastcall-event/Kconfig
```kconfig
# SPDX-License-Identifier: GPL-2.0

config FASTCALL_EVENT
	tristate "Fastcalls for an event wait mechanism similar to eventfd"
	depends on FASTCALL && X86_64
	default m
	help
	  This driver provides fastcalls which allow applications to wait for
	  events triggered by other applications using the MWAIT instruction.
	  They can be used to create an interface similar to eventfd.

	  The command-line arguments "-overcommit cpu-pm=on" need to be added
	  to QEMU when using this module as it requires MWAIT support. However,
	  this will prevent KVM from detecting when the guest kernel idles.
```

## drivers/fastcall-examples/Kconfig
```kconfig
# SPDX-License-Identifier: GPL-2.0
config FASTCALL_EXAMPLES
	tristate "Driver with example fastcalls"
	depends on FASTCALL && X86_64
	default y
	help
	  Enable the fastcall-examples driver, which adds some example fastcalls
	  for testing and benchmarking the fastcall mechanism.
	  The driver is found at /dev/fastcall-examples and controlled via ioctl.
	  It offers test functions for the fastcall stack, private memory and array copying.
```

## drivers/fastcall-in-c/Kconfig
```kconfig
# SPDX-License-Identifier: GPL-2.0

config FASTCALL_IN_C
	tristate "Example fastcall driver for writing fastcall functions in C"
	depends on FASTCALL
	default m
	help
	  This driver provides examples and tools for writing fastcall functions
		in C.
```

## drivers/fastcall-template/Kconfig
```kconfig
# SPDX-License-Identifier: GPL-2.0

# This config entry allows to build this driver
# into the kernel image or as a module.
# Of course, it depends on fastcall.
config FASTCALL_TEMPLATE
	tristate "Template for fastcall-based drivers"
	depends on FASTCALL
	default n
	help
	  To learn more about this template, read the
	  drivers/fastcall-template/Readme.md .
```

## drivers/fccmp/Kconfig
```kconfig
# SPDX-License-Identifier: GPL-2.0

menu "FCCMP benchmark comparison"

config FCCMP_ARRAY
	bool

config FCCMP_IOCTL
	tristate "Character device for comparing ioctls with fastcalls"
	default y
	select FCCMP_ARRAY
	help
	  Creates a device /dev/fccmp which accepts ioctl system calls.
	  These ioctl calls are used as a comparison when benchmarking the
	  fastcall mechanism.

config FCCMP_SYSCALL
	bool "New system calls as a comparison to the fastcall mechanism"
	default y
	depends on X86_64
	select FCCMP_ARRAY

config FCCMP_NT
	bool "Function for copying a char sequence with a non-temporal hint"
	default y
	depends on FCCMP_ARRAY && X86_64
	help
	  This relies on AVX2 and is only available for x86_64.

config FCCMP_VDSO
	bool "Provide vDSO functions as a comparison to the fastcall mechanism"
	default y
	depends on X86

config FCCMP_EVENT
	tristate "eventfd-like interface based on mwait"
	default y
	depends on X86_64
	help
	  Creates the device /dev/fccmp-event. Upon opening, this device holds
	  an internal counter and exposes an eventfd-like interface. However,
	  the waiting is realized via mwait instead of wait queues. This device
	  driver is used as a comparison to the fastcall-based realization.

endmenu
```

## drivers/syscall-bench/Kconfig
```kconfig
# SPDX-License-Identifier: GPL-2.0

menu "System call benchmark"

config SYSCALL_BENCH
	bool "Measure the latency of steps in the system call execution"
	default y
	depends on X86_64 && !PARAVIRT_XXL
	help
	  This adds a new system call, which takes latency measurements during
	  invocation and exposes them to the user.
	  WARNING: This compromises kernel security and adds latency to all
	  system calls.

config SYSCALL_BENCH_SERIAL
	bool "Surround cycle measurements with serializing instructions"
	default y
	depends on SYSCALL_BENCH
	help
	  Without these serializing instructions, cycle counts might not be
	  measured at the position declared in the code.

endmenu
```
